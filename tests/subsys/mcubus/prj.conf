## CMakeLists.txt
```
# Copyright (c) 2026 Christoph Jans <jans.christoph@gmail.com>
# SPDX-License-Identifier: Apache-2.0

cmake_minimum_required(VERSION 3.20.0)

find_package(Zephyr REQUIRED HINTS $ENV{ZEPHYR_BASE})
project(mcubus_test)

target_sources(app PRIVATE src/bus.c src/settings.c)
```

## prj.conf
```kconfig
# Copyright (c) 2026 Christoph Jans <jans.christoph@gmail.com>
# SPDX-License-Identifier: Apache-2.0

CONFIG_ZTEST=y
CONFIG_I2C=y
CONFIG_FLASH=y
CONFIG_FLASH_MAP=y
CONFIG_NVS=y
CONFIG_SETTINGS=y
CONFIG_SETTINGS_NVS=y
CONFIG_MCUBUS_SETTINGS=y
CONFIG_ZTEST_STACK_SIZE=2048
CONFIG_SYSTEM_WORKQUEUE_STACK_SIZE=2048
# The emulated bus times every byte, see samples/mcubus/settings/prj.conf
CONFIG_SYS_CLOCK_TICKS_PER_SEC=100000
```

## src/bus.c
```c
/*
 * Copyright (c) 2026 Christoph Jans <jans.christoph@gmail.com>
 *
 * SPDX-License-Identifier: Apache-2.0
 *
 * The mcubus under faults, and its ping service. The emulated port can address
 * its own target (`loopback`), so these tests send raw transfers to this MCU's target, over
 * the bus and through its interrupt: what a broken or foreign controller could
 * send, and what a controller that lost its place leaves behind. A test service
 * counts how often a request really ran.
 */

#include <zephyr/drivers/i2c.h>
#include <zephyr/sys/atomic.h>
#include <zephyr/ztest.h>

#include <drivers/i2c/i2c_mm_emul.h>
#include <mcubus/mcubus.h>

#define ADDR       DT_REG_ADDR(MCUBUS_SELF)
#define EMPTY_ADDR 0x55
#define CMD_COUNT  0x7e /* the test service */
#define CMD_NONE   0x7d /* no service */

static atomic_t runs;

/* The payload of the response is how often it ran, this time included */
static int count(const uint8_t *req, size_t len, uint8_t *rsp)
{
	rsp[0] = atomic_inc(&runs) + 1;
	return 1;
}

MCUBUS_SERVICE_DEFINE(test_count_service, CMD_COUNT, count);

/* Raw transfers to this MCU's own target, over the bus; the response is status, payload */
static int request(const uint8_t *req, size_t req_len, uint8_t *rsp, size_t rsp_len)
{
	return i2c_write_read(mcubus_i2c(), ADDR, req, req_len, rsp, rsp_len);
}

static const uint8_t count_req[] = {CMD_COUNT};

ZTEST(mcubus_faults, test_request)
{
	atomic_val_t before = atomic_get(&runs);
	uint8_t rsp[2];

	zassert_ok(request(count_req, 1, rsp, sizeof(rsp)));
	zassert_equal(rsp[0], 0);
	zassert_equal(rsp[1], before + 1);
	zassert_equal(atomic_get(&runs), before + 1);
}

/* A read without a request (a bus scan) gets -EINVAL, and does not run the last request */
ZTEST(mcubus_faults, test_read_alone)
{
	uint8_t rsp[2];
	atomic_val_t before;

	zassert_ok(request(count_req, 1, rsp, sizeof(rsp)));
	before = atomic_get(&runs);

	zassert_ok(i2c_read(mcubus_i2c(), rsp, sizeof(rsp), ADDR));
	zassert_equal((int8_t)rsp[0], -EINVAL);
	zassert_equal(atomic_get(&runs), before, "the last request ran again");
}

/* A request whose controller gave up before the read does not run, not even later */
ZTEST(mcubus_faults, test_write_alone)
{
	atomic_val_t before = atomic_get(&runs);
	uint8_t rsp[2];

	zassert_ok(i2c_write(mcubus_i2c(), count_req, 1, ADDR));
	zassert_ok(i2c_read(mcubus_i2c(), rsp, sizeof(rsp), ADDR));
	zassert_equal((int8_t)rsp[0], -EINVAL);
	zassert_equal(atomic_get(&runs), before);
}

/*
 * The controller reads only part of the response (it was reset during the read):
 * the request ran once, and the next one gets its own fresh response
 */
ZTEST(mcubus_faults, test_lost_response)
{
	atomic_val_t before = atomic_get(&runs);
	uint8_t rsp[2];

	zassert_ok(request(count_req, 1, rsp, 1));
	zassert_equal(atomic_get(&runs), before + 1);

	zassert_ok(request(count_req, 1, rsp, sizeof(rsp)));
	zassert_equal(rsp[0], 0);
	zassert_equal(rsp[1], before + 2);
}

/* A request longer than MCUBUS_MSG_MAX is NACKed and not run; the next one works */
ZTEST(mcubus_faults, test_too_long)
{
	uint8_t req[MCUBUS_MSG_MAX + 1] = {CMD_COUNT};
	atomic_val_t before = atomic_get(&runs);
	uint8_t rsp[2];

	zassert_equal(request(req, sizeof(req), rsp, sizeof(rsp)), -EIO);
	zassert_equal(atomic_get(&runs), before);

	zassert_ok(request(count_req, 1, rsp, sizeof(rsp)));
	zassert_equal(rsp[1], before + 1);
}

ZTEST(mcubus_faults, test_unknown_cmd)
{
	const uint8_t req[] = {CMD_NONE};
	uint8_t rsp[2];

	zassert_ok(request(req, sizeof(req), rsp, sizeof(rsp)));
	zassert_equal((int8_t)rsp[0], -ENOTSUP);
}

/* A target holds SDA low: the driver recovers the bus, and the request gets through */
ZTEST(mcubus_faults, test_stuck_bus)
{
	struct i2c_mm_emul_stats before, after;
	struct mcubus_info info;

	i2c_mm_emul_get_stats(mcubus_i2c(), &before);
	i2c_mm_emul_stick_bus(mcubus_i2c());

	zassert_equal(mcubus_ping(EMPTY_ADDR, &info), -EIO, "not through to the NACK");
	i2c_mm_emul_get_stats(mcubus_i2c(), &after);
	zassert_equal(after.recoveries, before.recoveries + 1);
}

ZTEST_SUITE(mcubus_faults, NULL, NULL, NULL, NULL, NULL);

ZTEST(mcubus_ping, test_ping)
{
	struct mcubus_info info;

	zassert_ok(mcubus_ping(ADDR, &info));
	zassert_equal(info.version, MCUBUS_PROTOCOL_VERSION);
	zassert_equal(info.msg_max, MCUBUS_MSG_MAX);
}

/* The same over the bus: cmd 0x00, response status, version, MCUBUS_MSG_MAX */
ZTEST(mcubus_ping, test_ping_on_the_wire)
{
	const uint8_t req[] = {MCUBUS_CMD_PING};
	uint8_t rsp[3];

	zassert_ok(request(req, sizeof(req), rsp, sizeof(rsp)));
	zassert_equal(rsp[0], 0);
	zassert_equal(rsp[1], MCUBUS_PROTOCOL_VERSION);
	zassert_equal(rsp[2], MCUBUS_MSG_MAX);
}

ZTEST(mcubus_ping, test_ping_nobody)
{
	struct mcubus_info info;

	zassert_equal(mcubus_ping(EMPTY_ADDR, &info), -EIO);
}

ZTEST_SUITE(mcubus_ping, NULL, NULL, NULL, NULL, NULL);
```

## src/settings.c
```c
/*
 * Copyright (c) 2026 Christoph Jans <jans.christoph@gmail.com>
 *
 * SPDX-License-Identifier: Apache-2.0
 *
 * The settings service of the mcubus, with one MCU on the bus. Requests to the
 * MCU's own address do not go over the bus, so this covers the request handling
 * and the error codes, and the controller side only up to a NACK. Requests between MCUs need
 * several processes: samples/mcubus/settings.
 *
 * Settings of the test, subtree "t":
 *   t/ro   r    4 bytes
 *   t/rw   rw   up to MCUBUS_SETTINGS_VALUE_MAX bytes, stored
 */

#include <string.h>
#include <zephyr/kernel.h>
#include <zephyr/settings/settings.h>
#include <zephyr/spinlock.h>
#include <zephyr/ztest.h>

#include <drivers/i2c/i2c_mm_emul.h>
#include <mcubus/mcubus.h>
#include <mcubus/settings.h>

#define ADDR       DT_REG_ADDR(MCUBUS_SELF)
#define EMPTY_ADDR 0x55

static const uint8_t ro[4] = {0xde, 0xad, 0xbe, 0xef};

static struct k_spinlock lock;
static uint8_t rw[MCUBUS_SETTINGS_VALUE_MAX];
static uint8_t rw_len;
static atomic_t exports;

static int t_get(const char *key, char *val, int val_len_max)
{
	int len = -ENOENT;

	K_SPINLOCK(&lock) {
		if (settings_name_steq(key, "ro", NULL)) {
			len = sizeof(ro);
			memcpy(val, ro, MIN(len, val_len_max));
		} else if (settings_name_steq(key, "rw", NULL) && rw_len > 0) {
			len = rw_len;
			memcpy(val, rw, MIN(len, val_len_max));
		}
	}
	return len;
}

static int t_set(const char *key, size_t len, settings_read_cb read_cb, void *cb_arg)
{
	uint8_t data[MCUBUS_SETTINGS_VALUE_MAX];
	ssize_t ret;

	if (settings_name_steq(key, "ro", NULL)) {
		return -EACCES;
	}
	if (!settings_name_steq(key, "rw", NULL)) {
		return -ENOENT;
	}
	if (len == 0 || len > sizeof(data)) {
		return -EINVAL;
	}
	ret = read_cb(cb_arg, data, len);
	if (ret < 0) {
		return ret;
	}
	K_SPINLOCK(&lock) {
		memcpy(rw, data, len);
		rw_len = len;
	}
	return 0;
}

static int t_export(int (*export_func)(const char *name, const void *val, size_t val_len))
{
	uint8_t data[MCUBUS_SETTINGS_VALUE_MAX];
	uint8_t len;

	K_SPINLOCK(&lock) {
		len = rw_len;
		memcpy(data, rw, len);
	}
	atomic_inc(&exports);
	return len > 0 ? export_func("t/rw", data, len) : 0;
}

SETTINGS_STATIC_HANDLER_DEFINE(t, "t", t_get, t_set, NULL, t_export);

ZTEST(mcubus_settings, test_get)
{
	uint8_t val[MCUBUS_SETTINGS_VALUE_MAX];

	zassert_equal(mcubus_settings_get(ADDR, "t/ro", val, sizeof(val)), sizeof(ro));
	zassert_mem_equal(val, ro, sizeof(ro));
}

ZTEST(mcubus_settings, test_get_short_buffer)
{
	uint8_t val[2] = {0};

	/* the whole length, but only what fits */
	zassert_equal(mcubus_settings_get(ADDR, "t/ro", val, sizeof(val)), sizeof(ro));
	zassert_mem_equal(val, ro, sizeof(val));
}

ZTEST(mcubus_settings, test_unknown_key)
{
	uint8_t val[MCUBUS_SETTINGS_VALUE_MAX];

	zassert_equal(mcubus_settings_get(ADDR, "t/nothing", val, sizeof(val)), -ENOENT);
	zassert_equal(mcubus_settings_set(ADDR, "t/nothing", val, 1), -ENOENT);
	/* no handler for the subtree: settings_runtime_get() says -EINVAL */
	zassert_equal(mcubus_settings_get(ADDR, "nosuch/key", val, sizeof(val)), -EINVAL);
}

ZTEST(mcubus_settings, test_set_read_only)
{
	uint8_t val = 0;

	zassert_equal(mcubus_settings_set(ADDR, "t/ro", &val, 1), -EACCES);
}

ZTEST(mcubus_settings, test_too_long)
{
	char key[MCUBUS_SETTINGS_KEY_MAX + 1];
	uint8_t val[MCUBUS_SETTINGS_VALUE_MAX + 1] = {0};

	memset(key, 'k', sizeof(key) - 1);
	key[sizeof(key) - 1] = '\0';
	zassert_equal(mcubus_settings_get(ADDR, key, val, 1), -EINVAL);
	zassert_equal(mcubus_settings_set(ADDR, "t/rw", val, sizeof(val)), -EINVAL);
}

/* A SET is stored by a work item: settings_load() brings the value back */
ZTEST(mcubus_settings, test_set_stored)
{
	const uint8_t val[] = {1, 2, 3};
	uint8_t got[MCUBUS_SETTINGS_VALUE_MAX];
	atomic_val_t before = atomic_get(&exports);

	zassert_ok(mcubus_settings_set(ADDR, "t/rw", val, sizeof(val)));
	zassert_equal(mcubus_settings_get(ADDR, "t/rw", got, sizeof(got)), sizeof(val));
	zassert_mem_equal(got, val, sizeof(val));

	zassert_true(WAIT_FOR(atomic_get(&exports) > before, USEC_PER_SEC, k_msleep(1)),
		     "settings not saved");

	K_SPINLOCK(&lock) {
		rw_len = 0;
	}
	zassert_ok(settings_load_subtree("t"));
	zassert_equal(mcubus_settings_get(ADDR, "t/rw", got, sizeof(got)), sizeof(val));
	zassert_mem_equal(got, val, sizeof(val));
}

/* Over the bus, to an address where nobody is */
ZTEST(mcubus_settings, test_nobody_there)
{
	struct i2c_mm_emul_stats before, after;
	struct mcubus_stats bus;
	uint8_t val[MCUBUS_SETTINGS_VALUE_MAX];

	i2c_mm_emul_get_stats(mcubus_i2c(), &before);
	zassert_equal(mcubus_settings_get(EMPTY_ADDR, "t/ro", val, sizeof(val)), -EIO);
	i2c_mm_emul_get_stats(mcubus_i2c(), &after);
	zassert_equal(after.nacks, before.nacks + 1);
	mcubus_get_stats(&bus);
	zassert_equal(bus.sent, 0);
}

static void *setup(void)
{
	zassert_ok(settings_subsys_init());
	return NULL;
}

ZTEST_SUITE(mcubus_settings, NULL, setup, NULL, NULL, NULL);
```
