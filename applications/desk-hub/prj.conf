## CMakeLists.txt
```
cmake_minimum_required(VERSION 3.20.0)

find_package(Zephyr REQUIRED HINTS $ENV{ZEPHYR_BASE})
project(desk_hub)

zephyr_linker_sources(DATA_SECTIONS src/sections-ram.ld)
zephyr_iterable_section(NAME desk_hub_app GROUP DATA_REGION ${XIP_ALIGN_WITH_INPUT})

target_include_directories(app PRIVATE src/core src/platform src/apps/selector)
target_sources(app PRIVATE
  src/main.c
  src/core/app_registry.c
  src/core/app_runtime.c
  src/core/app_ui.c
  src/core/event.c
  src/platform/clock.c
  src/platform/display_backend.c
  src/platform/gpio_buttons.c
  src/apps/selector/app_manager.c
  src/apps/selector/app_selector_model.c
  src/apps/selector/app_selector_view.c
)
target_sources_ifdef(CONFIG_DESK_HUB_CONWAY app PRIVATE
  src/apps/conway/conway.c
  src/apps/conway/conway_model.c
  src/apps/conway/conway_view.c
)
target_sources_ifdef(CONFIG_DESK_HUB_CALENDAR app PRIVATE
  src/apps/calendar/calendar.c
  src/apps/calendar/calendar_model.c
  src/apps/calendar/calendar_view.c
)
target_sources_ifdef(CONFIG_DESK_HUB_EMULATOR app PRIVATE src/platform/emulator.c)

if(CONFIG_DESK_HUB_EMULATOR)
  target_sources(native_simulator INTERFACE
    ${CMAKE_CURRENT_SOURCE_DIR}/src/platform/emulator_window.c)
endif()
```

## Kconfig
```
# SPDX-License-Identifier: Apache-2.0

config DESK_HUB_CONWAY
	bool "Conway's Game of Life"
	default y
	depends on DISPLAY
	select ENTROPY_GENERATOR
	help
	  Build and run Conway's Game of Life on the Desk Hub display.

config DESK_HUB_CALENDAR
	bool "Calendar and time"
	default y
	depends on DISPLAY
	help
	  Build the calendar and time app for the Desk Hub display.

config DESK_HUB_EMULATOR
	bool "SDL emulator controls"
	default y
	depends on DT_HAS_ZEPHYR_SDL_DC_ENABLED && LV_Z_AUTO_INIT
	help
	  Initialize the simulator toolbar after the SDL display and LVGL.
	  The toolbar reserves its own space above the app content.

source "Kconfig.zephyr"
```

## prj.conf
```kconfig
CONFIG_DISPLAY=y
CONFIG_LVGL=y
CONFIG_LV_Z_COLOR_FORMAT_I1=y
CONFIG_LV_Z_MONOCHROME_CONVERSION_BUFFER=y
CONFIG_LV_Z_PARTIAL_REFRESH=y
CONFIG_LV_USE_CANVAS=y
# Widget styles, draw tasks and monochrome conversion share this heap.
CONFIG_LV_Z_MEM_POOL_SIZE=65536
CONFIG_LV_FONT_MONTSERRAT_18=y
CONFIG_LV_FONT_MONTSERRAT_24=y
CONFIG_MAIN_STACK_SIZE=4096

CONFIG_LV_FONT_MONTSERRAT_40=y
```

## boards/native_sim_native_64.conf
```kconfig
# SPDX-License-Identifier: Apache-2.0

CONFIG_SDL_DISPLAY_USE_HARDWARE_ACCELERATOR=n
# Use the same monochrome packing as the rotated display driver.
CONFIG_SDL_DISPLAY_MONO_VTILED=n
CONFIG_SDL_DISPLAY_MONO_MSB_FIRST=n

CONFIG_INPUT=y
CONFIG_INPUT_SDL_TOUCH=y
```

## boards/esp32s3_rlcd_4_2_esp32s3_procpu.overlay
```dts
/*
 * Copyright (c) 2026 Christoph Jans <jans.christoph@gmail.com>
 *
 * SPDX-License-Identifier: Apache-2.0
 */

&st7306 {
	/* Use forward column and data order for partial writes.
	 * The panel's 26 column addresses (17 through 42) are centered in GRAM.
	 */
	remap-value = <0x00>;
};
```

## boards/native_sim_native_64.overlay
```dts
/*
 * Copyright (c) 2026 Christoph Jans <jans.christoph@gmail.com>
 * SPDX-License-Identifier: Apache-2.0
 */

#include <zephyr/dt-bindings/display/panel.h>

&sdl_dc {
	title = "Desk Hub - Waveshare RLCD";
	width = <400>;
	height = <360>;
	pixel-format = <PANEL_PIXEL_FORMAT_MONO01>;
};
```

## src/main.c
```c
/*
 * Copyright (c) 2026 Christoph Jans <jans.christoph@gmail.com>
 *
 * SPDX-License-Identifier: Apache-2.0
 */

#include "app_manager.h"
#include "app_ui.h"
#include "display_backend.h"

int main(void)
{
	int ret = desk_hub_display_backend_init();

	if (ret < 0) {
		return ret;
	}
	ret = app_ui_init();
	if (ret < 0) {
		return ret;
	}
	return desk_hub_app_manager_run();
}
```
