## applications/warmguard/testcase.yaml
```yaml
tests:
  application.warmguard.alarm:
    platform_allow: [native_sim/native/64]
    integration_platforms: [native_sim/native/64]
    tags: [requirements, safety]
```

## west.yml
```yaml
# SPDX-License-Identifier: Apache-2.0
#
# The west manifest file for embedded systems based on Zephyr.

manifest:
  version: "0.13"

  defaults:
    remote: zephyrproject

  # further "remotes"
  remotes:
    - name: zephyrproject
      url-base: https://github.com/zephyrproject-rtos
    - name: janchri
      url-base: https://github.com/janchri

  self:
    path: ws-zephyr
    west-commands: scripts/west-commands.yml

  projects:

  - name: zephyr
    path: zephyr
    remote: zephyrproject
    repo-path: zephyr
    revision: v4.5.0

    import:
      # Keep this list sorted alphabetically.
      name-allowlist:
        - cmsis_6
        - fatfs
        - hal_espressif
        - hal_st
        - hal_stm32
        - hal_nordic
        - hal_rpi_pico
        - libmetal
        - littlefs
        - mbedtls
        - mcuboot
        - open-amp
        - segger
        - tf-psa-crypto
        - zcbor

  - name: twixt
    remote: janchri
    revision: main
    path: modules/lib/twixt

  # Documentation federation used by applications/warmguard.
  - name: zdocs
    url: https://github.com/tiacsys/zdocs
    revision: f9b701c1eba44221f60c50a2687215ec1aa137ee
    path: tools/zdocs
```
