/*
 * Copyright (c) 2026 Christoph Jans
 * SPDX-License-Identifier: Apache-2.0
 */

/* The MCUs on the bus, included in the bus node of each board overlay; shared by nodes and gateways.
 */


mcu_nrf: nrf@11 {
	compatible = "twixt,mcu";
	reg = <0x11>;
};

mcu_pico: pico@70 {
	compatible = "twixt,mcu";
	reg = <0x70>;
};

mcu_esp32: esp32@12 {
	compatible = "twixt,mcu";
	reg = <0x12>;
};
