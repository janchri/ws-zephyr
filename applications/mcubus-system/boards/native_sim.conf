## drivers/i2c/Kconfig
```kconfig
# Copyright (c) 2026 Christoph Jans <jans.christoph@gmail.com>
# SPDX-License-Identifier: Apache-2.0

config I2C_MM_EMUL
	bool "Multi-master I2C port for native_sim"
	default y
	depends on DT_HAS_ZEPHYR_I2C_MM_EMUL_ENABLED
	depends on ARCH_POSIX
	help
	  I2C controller and target of one native_sim process, on a bus shared
	  with other processes. See dts/bindings/i2c/zephyr,i2c-mm-emul.yaml.

menuconfig I2C_MM
	bool "Messages between equal MCUs on a multi-master I2C bus"
	select I2C_TARGET
	help
	  Requests and responses between equal MCUs, one I2C transfer each.
	  See <drivers/i2c/i2c_mm.h>.

if I2C_MM

config I2C_MM_MSG_MAX
	int "Longest request or response"
	default 64
	range 8 255
	help
	  In bytes. The same on every MCU of the bus.

config I2C_MM_RETRY_MS
	int "Retry time after lost arbitration or a busy bus, in ms"
	default 500

config I2C_MM_TARGET_REREGISTER
	bool "Register the target again after every transfer"
	default y if DT_HAS_SNPS_DESIGNWARE_I2C_ENABLED
	help
	  For drivers that leave target mode for a transfer and do not return
	  to it, such as the DesignWare driver (Raspberry Pi Pico).

module = I2C_MM
module-str = i2c_mm
source "subsys/logging/Kconfig.template.log_config"

endif # I2C_MM

# A byte on the emulated bus is 90 us; a coarser tick would round it up
configdefault SYS_CLOCK_TICKS_PER_SEC
	default 100000 if I2C_MM_EMUL
```

## drivers/serial/Kconfig
```kconfig
# Copyright (c) 2026 Christoph Jans <jans.christoph@gmail.com>
# SPDX-License-Identifier: Apache-2.0

config UART_MCUBUS
	bool "UART over the mcubus"
	default y
	depends on DT_HAS_ZEPHYR_MCUBUS_UART_ENABLED
	depends on MCUBUS
	select SERIAL_HAS_DRIVER
	select SERIAL_SUPPORT_INTERRUPT
	select UART_INTERRUPT_DRIVEN
	select RING_BUFFER
	help
	  See dts/bindings/mcubus/zephyr,mcubus-uart.yaml.

if UART_MCUBUS

config UART_MCUBUS_RX_BUF_SIZE
	int "Receive buffer of each UART"
	default 256

config UART_MCUBUS_TX_BUF_SIZE
	int "Transmit buffer of each UART"
	default 256

config UART_MCUBUS_CHUNK
	int "Most bytes in one request"
	default 32
	range 1 252
	help
	  Longer chunks cost less overhead, shorter ones hold the bus for less
	  time. Up to MCUBUS_DATA_MAX.

config UART_MCUBUS_POLL_MS
	int "Retry interval while the peer is full or the bus is taken, in ms"
	default 5

config UART_MCUBUS_THREAD_PRIORITY
	int "Priority of the UART thread"
	default 2

config UART_MCUBUS_THREAD_STACK_SIZE
	int "Stack size of the UART thread"
	default 1536

endif # UART_MCUBUS

# Interrupt-driven, as MCUmgr's shell transport needs; Zephyr defaults to polling
# on native_sim
DT_CHOSEN_SHELL_UART := zephyr,shell-uart
DT_COMPAT_MCUBUS_UART := zephyr,mcubus-uart

configdefault SHELL_BACKEND_SERIAL_INTERRUPT_DRIVEN
	default y if UART_MCUBUS && $(dt_chosen_has_compat,$(DT_CHOSEN_SHELL_UART),$(DT_COMPAT_MCUBUS_UART))
```

## dts/bindings/mcubus/zephyr,mcubus-node.yaml
```yaml
# Copyright (c) 2026 Christoph Jans <jans.christoph@gmail.com>
# SPDX-License-Identifier: Apache-2.0

description: |
  An MCU on the mcubus, at its I2C address. /chosen zephyr,mcubus-self is the
  MCU the image runs on. See include/mcubus/mcubus.h.

    &i2c0 {
            mcu_a: mcu-a@10 {
                    compatible = "zephyr,mcubus-node";
                    reg = <0x10>;
            };
    };

    / {
            chosen {
                    zephyr,mcubus-self = &mcu_a;
            };
    };

compatible: "zephyr,mcubus-node"

include: i2c-device.yaml
```

## dts/bindings/mcubus/zephyr,mcubus-uart.yaml
```yaml
# Copyright (c) 2026 Christoph Jans <jans.christoph@gmail.com>
# SPDX-License-Identifier: Apache-2.0

description: |
  A UART over the mcubus: a byte stream to one other MCU, peer. Point
  zephyr,shell-uart or zephyr,console at it, or bridge it with
  zephyr,uart-bridge.

    bus_uart: bus-uart {
            compatible = "zephyr,mcubus-uart";
            peer = <&gw>;
    };

compatible: "zephyr,mcubus-uart"

include: base.yaml

properties:
  peer:
    type: phandle
    required: true
    description: zephyr,mcubus-node at the other end
```

## samples/twixt/settings/sample.yaml
```yaml
# Copyright (c) 2026 Christoph Jans <jans.christoph@gmail.com>
# SPDX-License-Identifier: Apache-2.0

sample:
  name: Settings over twixt
common:
  platform_allow:
    - native_sim
  integration_platforms:
    - native_sim
  tags:
    - i2c
    - settings
tests:
  # MCU a, started by twister; pytest/test_settings.py starts b next to it
  sample.twixt.settings:
    extra_args: NODE=a
    harness: pytest
    required_applications:
      - name: sample.twixt.settings.node_b
  sample.twixt.settings.node_b:
    extra_args: NODE=b
    build_only: true
```

## subsys/mcubus/Kconfig
```kconfig
# Copyright (c) 2026 Christoph Jans <jans.christoph@gmail.com>
# SPDX-License-Identifier: Apache-2.0

DT_CHOSEN_MCUBUS_SELF := zephyr,mcubus-self

menuconfig MCUBUS
	bool "Requests between equal MCUs on a multi-master I2C bus"
	default y if $(dt_chosen_enabled,$(DT_CHOSEN_MCUBUS_SELF))
	depends on I2C
	select I2C_MM
	help
	  On with /chosen zephyr,mcubus-self. See <mcubus/mcubus.h>.

if MCUBUS

config MCUBUS_INIT_PRIORITY
	int "Init priority"
	default 60
	help
	  After the I2C driver.

config MCUBUS_SHELL
	bool "Shell commands"
	default y
	depends on SHELL

config MCUBUS_PING
	bool "Ping service"
	default y
	help
	  Every MCU should answer it. See <mcubus/ping.h>.

rsource "Kconfig.settings"

module = MCUBUS
module-str = mcubus
source "subsys/logging/Kconfig.template.log_config"

endif # MCUBUS
```

## subsys/mcubus/Kconfig.settings
```kconfig
# Copyright (c) 2026 Christoph Jans <jans.christoph@gmail.com>
# SPDX-License-Identifier: Apache-2.0

menuconfig MCUBUS_SETTINGS
	bool "Settings service"
	depends on SETTINGS
	select SETTINGS_RUNTIME
	help
	  See <mcubus/settings.h>.

if MCUBUS_SETTINGS

config MCUBUS_SETTINGS_KEY_MAX
	int "Longest key, NUL included"
	default 24
	range 2 128

config MCUBUS_SETTINGS_VALUE_MAX
	int "Longest value"
	default 16
	range 1 251
	help
	  Op, key and value of a set must fit MCUBUS_DATA_MAX.

endif # MCUBUS_SETTINGS
```

## west.yml
```yaml
# SPDX-License-Identifier: Apache-2.0
#
# The west manifest file for embedded systems based on Zephyr.

manifest:
  version: "0.13"

  defaults:
    remote: zephyrproject

  # further "remotes"
  remotes:
    - name: zephyrproject
      url-base: https://github.com/zephyrproject-rtos
    - name: janchri
      url-base: https://github.com/janchri

  self:
    path: ws-zephyr

  projects:

  - name: zephyr
    path: zephyr
    remote: zephyrproject
    repo-path: zephyr
    revision: v4.5.0-rc2

    import:
      # Keep this list sorted alphabetically.
      name-allowlist:
        - cmsis_6
        - fatfs
        - hal_espressif
        - hal_st
        - hal_stm32
        - hal_nordic
        - hal_rpi_pico
        - littlefs
        - mbedtls
        - mcuboot
        - segger
        - tf-psa-crypto
        - zcbor

  - name: twixt
    remote: janchri
    revision: main
    path: modules/lib/twixt
```
